## Kconfig
```kconfig
# 2024 t0bybr

config ZMK_PIMORONI_PIM447
  bool "Pimoroni PIM447 Trackball support"
  select ZMK_MOUSE
  select I2C
  select GPIO
  help
    Enable driver for Pimoroni  Trackball.

if ZMK_PIMORONI_PIM447

  config ZMK_PIMORONI_PIM447_BEHAVIORS
    bool "Enable Pimoroni PIM447 Trackball Actions behavior"
    depends on ZMK_PIMORONI_PIM447
    select ZMK_BEHAVIORS
    # default y
    help
      Enable Pimoroni PIM447 Trackball behaviors.

endif # ZMK_PIMORONI_PIM447
```

## dts/bindings/behaviors/zmk,behavior-adjust-variable.yaml
```yaml
# Copyright (c) 2021 The ZMK Contributors
# SPDX-License-Identifier: MIT

description: Custom behavior to adjust variables like speed_min, speed_max, etc.

compatible: "zmk,behavior-adjust-variable"

include: zero_param.yaml
```

## dts/bindings/behaviors/zmk,behavior-trackball-adjust.yaml
```yaml
# Copyright (c) 2021 The ZMK Contributors
# SPDX-License-Identifier: MIT

description: Custom behavior to adjust trackball parameters via keypresses.

compatible: "behavior-trackball-adjust"

include: base.yaml

properties:
  "#binding-cells":
    const: 1

  action:
    type: int
    required: false
    description: The action to perform.
```

## dts/bindings/input/zmk,pimoroni-pim447.yaml
```yaml
# SPDX-License-Identifier: MIT
compatible: "zmk,pimoroni-pim447"
description: Driver for the Pimoroni PIM447 Trackball
include:
  - name: i2c.yaml

properties:
  int-gpios:
    type: phandle-array
    required: true
    description: GPIO pin connected to the INT line of the PIM447
```

## dts/bindings/sensor/pimoroni,pim447.yaml
```yaml
description: Pimoroni Trackball

compatible: "pimoroni,pim447"

include: i2c-device.yaml

properties:
  reg:
    required: true
    description: I2C address of the trackball

  int-gpios:
    type: phandle-array
    required: true
    description: Interrupt pin

  move_factor:
    type: int
    required: true
    description: The factor to multiply the movement by
    default: 1

  led-red-gpios:
    type: phandle-array
    required: false
    description: GPIO for red LED control (optional)

  led-green-gpios:
    type: phandle-array
    required: false
    description: GPIO for green LED control (optional)

  led-blue-gpios:
    type: phandle-array
    required: false
    description: GPIO for blue LED control (optional)

  led-white-gpios:
    type: phandle-array
    required: false
    description: GPIO for white LED control (optional)
```
